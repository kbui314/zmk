/*
 * Copyright (c) 2020 Pete Johanson
 *
 * SPDX-License-Identifier: MIT
 */

#include "corne.dtsi"

&kscan0 {
	row-gpios
		= <&gpio0 5 (GPIO_ACTIVE_HIGH | GPIO_PULL_DOWN)>;
	col-gpios
		= <&gpio0 8 GPIO_ACTIVE_HIGH>;
};