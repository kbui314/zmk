## app/boards/shields/ergoblue/Kconfig.defconfig
```kconfig
# Copyright (c) 2020 The ZMK Contributors
# SPDX-License-Identifier: MIT

if SHIELD_ERGOBLUE_CENTRAL

config ZMK_KEYBOARD_NAME
	default "ErgoBlue"

endif

config ZMK_SPLIT
	default y
```

## app/boards/shields/ergoblue/Kconfig.shield
```kconfig
# Copyright (c) 2020 The ZMK Contributors
# SPDX-License-Identifier: MIT

config SHIELD_ERGOBLUE_CENTRAL
	def_bool $(shields_list_contains,ergoblue_central)

config SHIELD_ERGOBLUE_LEFT
	def_bool $(shields_list_contains,ergoblue_left)

config SHIELD_ERGOBLUE_RIGHT
	def_bool $(shields_list_contains,ergoblue_right)
```
