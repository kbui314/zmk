/*
 * Copyright (c) 2020 The ZMK Contributors
 *
 * SPDX-License-Identifier: MIT
 */

#include "ergoblue.dtsi"

&kscan0 {
	// TODO TODO TODO dummy
	row-gpios
		= <&gpio0 5 (GPIO_ACTIVE_HIGH | GPIO_PULL_DOWN)>;
	col-gpios
		= <&gpio0 8 GPIO_ACTIVE_HIGH>;
};
